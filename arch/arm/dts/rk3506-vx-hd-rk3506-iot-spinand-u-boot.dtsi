// SPDX-License-Identifier: (GPL-2.0+ OR MIT)

#include "rk3506-u-boot.dtsi"

/ {
	chosen {
		u-boot,spl-boot-order = "same-as-spl", &sdmmc, &flash;
	};
};

&flash {
	bootph-pre-ram;
	bootph-some-ram;
};

&sdmmc_det_pin {
	bootph-pre-ram;
	bootph-some-ram;
};
